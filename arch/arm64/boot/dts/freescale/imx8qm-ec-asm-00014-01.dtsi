// SPDX-License-Identifier: GPL-2.0+
/*
 * Copyright 2018-2019 NXP
 *	Dong Aisheng <aisheng.dong@nxp.com>
 *
 * Copyright 2024 Refeyn
 *	Matthew Joyce <matthew.joyce@refeyn.com>
 */

#include <dt-bindings/usb/pd.h>
#include <dt-bindings/leds/common.h>
#include <dt-bindings/pwm/pwm.h>
#include "imx8qm.dtsi"

// CSI0/CSI1 not setup as we have no target device
// Aux card pwm not setup
// Aux card USB-C not setup as we have no target power/crossbar ICs

/ {
	model = "Refeyn i.MX8QM EC-ASM-00014-01";
	compatible = "fsl,imx8qm-ec-asm-00014-01", "fsl,imx8qm";

	chosen {
		stdout-path = &lpuart1;
	};

	// Memory stuff

	memory@80000000 {
		device_type = "memory";
		reg = <0x00000000 0x80000000 0x00000000 0x80000000>;
	};

	reserved-memory {
		#address-cells = <2>;
		#size-cells = <2>;
		ranges;

		gpu_reserved: gpu_reserved@8800000000 {
			no-map;
			reg = <0x8 0x80000000 0 0x10000000>;
		};

		dsp_reserved: dsp@92400000 {
			reg = <0 0x92400000 0 0x1000000>;
			no-map;
		};

		dsp_reserved_heap: dsp_reserved_heap {
			reg = <0 0x93400000 0 0xef0000>;
			no-map;
		};

		dsp_vdev0vring0: vdev0vring0@942f0000 {
			reg = <0 0x942f0000 0 0x8000>;
			no-map;
		};

		dsp_vdev0vring1: vdev0vring1@942f8000 {
			reg = <0 0x942f8000 0 0x8000>;
			no-map;
		};

		dsp_vdev0buffer: vdev0buffer@94300000 {
			compatible = "shared-dma-pool";
			reg = <0 0x94300000 0 0x100000>;
			no-map;
		};

		decoder_boot: decoder_boot@84000000 {
			no-map;
			reg = <0 0x84000000 0 0x2000000>;
		};

		decoder_rpc: decoder_rpc@92000000 {
			no-map;
			reg = <0 0x92000000 0 0x100000>;
		};

		encoder1_boot: encoder1_boot@86000000 {
			no-map;
			reg = <0 0x86000000 0 0x200000>;
		};

		encoder2_boot: encoder2_boot@86200000 {
			no-map;
			reg = <0 0x86200000 0 0x200000>;
		};

		encoder1_rpc: encoder1_rpc@94400000 {
			no-map;
			reg = <0 0x94400000 0 0x700000>;
		};

		encoder2_rpc: encoder1_rpc@94b00000 {
			no-map;
			reg = <0 0x94b00000 0 0x700000>;
		};

		/* global autoconfigured region for contiguous allocations */
		linux,cma {
			compatible = "shared-dma-pool";
			reusable;
			size = <0 0x3c000000>;
			alloc-ranges = <0 0xc0000000 0 0x3c000000>;
			linux,cma-default;
		};

		vdevbuffer: vdevbuffer {
			compatible = "shared-dma-pool";
			reg = <0 0x90400000 0 0x100000>;
			no-map;
		};

		vdev0vring0: vdev0vring0@90000000 {
			reg = <0 0x90000000 0 0x8000>;
			no-map;
		};

		vdev0vring1: vdev0vring1@90008000 {
			reg = <0 0x90008000 0 0x8000>;
			no-map;
		};

		vdev1vring0: vdev1vring0@90010000 {
			reg = <0 0x90010000 0 0x8000>;
			no-map;
		};

		vdev1vring1: vdev1vring1@90018000 {
			reg = <0 0x90018000 0 0x8000>;
			no-map;
		};

		rsc_table0: rsc-table@900ff000 {
			reg = <0 0x900ff000 0 0x1000>;
			no-map;
		};

		vdev2vring0: vdev0vring0@90100000 {
			reg = <0 0x90100000 0 0x8000>;
			no-map;
		};

		vdev2vring1: vdev0vring1@90108000 {
			reg = <0 0x90108000 0 0x8000>;
			no-map;
		};

		vdev3vring0: vdev1vring0@90110000 {
			reg = <0 0x90110000 0 0x8000>;
			no-map;
		};

		vdev3vring1: vdev1vring1@90118000 {
			reg = <0 0x90118000 0 0x8000>;
			no-map;
		};

		rsc_table1: rsc-table@901ff000 {
			reg = <0 0x901ff000 0 0x1000>;
			no-map;
		};
	};

	// Regulators

	reg_pmic_ldo_vselect0: regulator-pmic-ldo-vselect0 {
		compatible = "regulator-fixed";
		pinctrl-names = "default";
		pinctrl-0 = <&pinctrl_pmic_ldo0>;
		regulator-name = "reg_pmic_ldo_vselect0";
		regulator-min-microvolt = <3300000>;
		regulator-max-microvolt = <3300000>;
		gpio = <&lsio_gpio4 8 GPIO_ACTIVE_LOW>;
		regulator-always-on;
	};

	reg_level_shifters_enable: regulator-level-shifters-enable {
		compatible = "regulator-fixed";
		pinctrl-names = "default";
		pinctrl-0 = <&pinctrl_level_shifters>;
		regulator-name = "reg_level_shifters_enable";
		regulator-min-microvolt = <3300000>;
		regulator-max-microvolt = <3300000>;
		gpio = <&lsio_gpio2 15 GPIO_ACTIVE_HIGH>;
		enable-active-high;
		regulator-always-on;
	};

	reg_vref_1v8: regulator-adc-vref {
		compatible = "regulator-fixed";
		regulator-name = "vref_1v8";
		regulator-min-microvolt = <1800000>;
		regulator-max-microvolt = <1800000>;
	};

	// M4 core communication

	cm4 {
		#address-cells = <1>;
		#size-cells = <0>;
		compatible = "simple-bus";

		imx8qm_cm40: imx8qm_cm4@0 {
			compatible = "fsl,imx8qm-cm4";
			rsc-da = <0x90000000>;
			mbox-names = "tx", "rx", "rxdb";
			mboxes = <&lsio_mu5 0 1
				&lsio_mu5 1 1
				&lsio_mu5 3 1>;
			memory-region = <&vdevbuffer>, <&vdev0vring0>, <&vdev0vring1>,
					<&vdev1vring0>, <&vdev1vring1>, <&rsc_table0>;
			fsl,resource-id = <IMX_SC_R_M4_0_PID0>;
			fsl,entry-address = <0x34fe0000>;
			status = "okay";
			power-domains = <&pd IMX_SC_R_M4_0_PID0>,
					<&pd IMX_SC_R_M4_0_MU_1A>;
		};

		imx8qm_cm41: imx8x_cm4@1 {
			compatible = "fsl,imx8qm-cm4";
			rsc-da = <0x90100000>;
			mbox-names = "tx", "rx", "rxdb";
			mboxes = <&lsio_mu6 0 1
				&lsio_mu6 1 1
				&lsio_mu6 3 1>;
			memory-region = <&vdevbuffer>, <&vdev2vring0>, <&vdev2vring1>,
					<&vdev3vring0>, <&vdev3vring1>, <&rsc_table1>;
			fsl,resource-id = <IMX_SC_R_M4_1_PID0>;
			fsl,entry-address = <0x38fe0000>;
			status = "okay";
			power-domains = <&pd IMX_SC_R_M4_1_PID0>,
					<&pd IMX_SC_R_M4_1_MU_1A>;
		};
	};

	// MIPI backlights

	mipi_dsi0_backlight: mipi_backlight@0 {
		compatible = "pwm-backlight";
		pwms = <&pwm_mipi0 0 2000000 0>; // 500Hz
		brightness-levels = <0 4 8 16 32 64 128 255>;
		default-brightness-level = <6>;
		status = "disabled";
	};

	mipi_dsi1_backlight: mipi_backlight@1 {
		compatible = "pwm-backlight";
		pwms = <&pwm_mipi1 0 2000000 0>; // 500Hz
		brightness-levels = <0 4 8 16 32 64 128 255>;
		default-brightness-level = <6>;
		status = "disabled";
	};

	// LEDs

	led-controller {
		compatible = "gpio-leds";
		pinctrl-names = "default";
		pinctrl-0 = <&pinctrl_leds>;

		led@0 {
			function = LED_FUNCTION_INDICATOR;
			color = <LED_COLOR_ID_GREEN>;
			linux,default-trigger = "heartbeat";
			panic-indicator;
			gpios = <&lsio_gpio0 20 GPIO_ACTIVE_HIGH>;
			default-state = "off";
		};

		led@1 {
			function = LED_FUNCTION_STATUS;
			color = <LED_COLOR_ID_RED>;
			linux,default-trigger = "none";
			panic-indicator;
			gpios = <&lsio_gpio0 21 GPIO_ACTIVE_HIGH>;
			default-state = "off";
		};
	};

	// Voltage/current monitoring
	// TODO update values

	sys_24v_voltage: sys-24v-voltage {
		#io-channel-cells = <0>;
		compatible = "voltage-divider";
		io-channels = <&adc0 0>;

		output-ohms = <1>;
		full-ohms = <1>;
	};

	sys_24v_current: sys-24v-current {
		#io-channel-cells = <0>;
		compatible = "current-sense-amplifier";
		io-channels = <&adc0 1>;

		sense-resistor-micro-ohms = <1>;
		sense-gain-mult = <1>;
	};

	sys_aux24v_voltage: sys-aux24v-voltage {
		#io-channel-cells = <0>;
		compatible = "voltage-divider";
		io-channels = <&adc0 2>;

		output-ohms = <1>;
		full-ohms = <1>;
	};

	sys_aux24v_current: sys-aux24v-current {
		#io-channel-cells = <0>;
		compatible = "current-sense-amplifier";
		io-channels = <&adc0 3>;

		sense-resistor-micro-ohms = <1>;
		sense-gain-mult = <1>;
	};

	sys_5v_voltage: sys-5v-voltage {
		#io-channel-cells = <0>;
		compatible = "voltage-divider";
		io-channels = <&adc1 0>;

		output-ohms = <1>;
		full-ohms = <1>;
	};

	sys_5v_current: sys-5v-current {
		#io-channel-cells = <0>;
		compatible = "current-sense-amplifier";
		io-channels = <&adc1 1>;

		sense-resistor-micro-ohms = <1>;
		sense-gain-mult = <1>;
	};

	sys_3v3_voltage: sys-3v3-voltage {
		#io-channel-cells = <0>;
		compatible = "voltage-divider";
		io-channels = <&adc1 2>;

		output-ohms = <1>;
		full-ohms = <1>;
	};

	sys_3v3_current: sys-3v3-current {
		#io-channel-cells = <0>;
		compatible = "current-sense-amplifier";
		io-channels = <&adc1 3>;

		sense-resistor-micro-ohms = <1>;
		sense-gain-mult = <1>;
	};

	// Fans

	pwm_fan0: pwm-fan0 {
		compatible = "pwm-fan";
		pinctrl-names = "default";
		pinctrl-0 = <&pinctrl_fan0>;
		pwms = <&lsio_pwm0 0 100000 PWM_POLARITY_INVERTED>;
		interrupt-parent = <&lsio_gpio1>;
		interrupts = <0 IRQ_TYPE_EDGE_FALLING>;
		pulses-per-revolution = <2>;
		cooling-levels = <0 50 100 150 200 255>;
		#cooling-cells = <2>;
	};

	pwm-fan1 {
		compatible = "pwm-fan";
		pinctrl-names = "default";
		pinctrl-0 = <&pinctrl_fan1>;
		pwms = <&lsio_pwm1 0 100000 PWM_POLARITY_INVERTED>;
		interrupt-parent = <&lsio_gpio1>;
		interrupts = <1 IRQ_TYPE_EDGE_FALLING>;
		pulses-per-revolution = <2>;
		cooling-levels = <0 50 100 150 200 255>;
		#cooling-cells = <2>;
	};

	pwm-fan2 {
		compatible = "pwm-fan";
		pinctrl-names = "default";
		pinctrl-0 = <&pinctrl_fan2>;
		pwms = <&lsio_pwm2 0 100000 PWM_POLARITY_INVERTED>;
		interrupt-parent = <&lsio_gpio1>;
		interrupts = <2 IRQ_TYPE_EDGE_FALLING>;
		pulses-per-revolution = <2>;
		cooling-levels = <0 50 100 150 200 255>;
		#cooling-cells = <2>;
	};

	// HDMI TX
	sound-hdmi-tx {
		compatible = "fsl,imx-audio-hdmi";
		model = "imx-audio-hdmi-tx";
		audio-cpu = <&sai5>;
		protocol = <1>;
		hdmi-out;
	};

	sound-hdmi-arc {
		compatible = "fsl,imx-audio-spdif";
		model = "imx-hdmi-arc";
		spdif-controller = <&spdif1>;
		spdif-in;
		spdif-out;
	};

	// Includes for CM40 access
	#include "imx8-ss-cm40.dtsi"
};

// FlexSPI1 (aux card QSPI)
&lsio_subsys {
    // FIXME Broken as the addr is 64 bit but the bus only has one address cell
	flexspi1: spi@5d130000 {
		#address-cells = <1>;
		#size-cells = <0>;
		compatible = "nxp,imx8qxp-fspi";
		reg = <0x5d130000 0x10000>, <0x4 0x00000000 0x10000000>;
		reg-names = "fspi_base", "fspi_mmap";
		interrupts = <GIC_SPI 93 IRQ_TYPE_LEVEL_HIGH>;
		clocks = <&clk IMX_SC_R_FSPI_1 IMX_SC_PM_CLK_PER>,
			<&clk IMX_SC_R_FSPI_1 IMX_SC_PM_CLK_PER>;
		clock-names = "fspi", "fspi_en";
		power-domains = <&pd IMX_SC_R_FSPI_1>;
		status = "disabled";
	};
};

// DSI0 - on-board connector (backlight is defined above)

&mipi0_subsys {
	// Clocks for the MIPI DSI0 PWM subsystem
	mipi0_pwm_lpcg_ipg_clk_highfreq: clock-controller@56223010 {
		compatible = "fsl,imx8qxp-lpcg";
		reg = <0x56223010 0x4>;
		#clock-cells = <1>;
		clocks = <&clk IMX_SC_R_MIPI_0_PWM_0 IMX_SC_PM_CLK_PER>;
		bit-offset = <0>;
		clock-output-names = "mipi0_pwm_lpcg_ipg_clk_highfreq";
		power-domains = <&pd IMX_SC_R_MIPI_0_PWM_0>;
	};

	mipi0_pwm_lpcg_ipg_s_clk: clock-controller@5622300c {
		compatible = "fsl,imx8qxp-lpcg";
		reg = <0x5622300c 0x4>;
		#clock-cells = <1>;
		clocks = <&dsi_ipg_clk>;
		bit-offset = <0>;
		clock-output-names = "mipi0_pwm_lpcg_ipg_s_clk";
		power-domains = <&pd IMX_SC_R_MIPI_0_PWM_0>;
	};

	mipi0_pwm_lpcg_ipg_clk: clock-controller@56223008 {
		compatible = "fsl,imx8qxp-lpcg";
		reg = <0x56223008 0x4>;
		#clock-cells = <1>;
		clocks = <&mipi0_pwm_lpcg_ipg_s_clk 0>;
		bit-offset = <0>;
		clock-output-names = "mipi0_pwm_lpcg_ipg_clk";
		power-domains = <&pd IMX_SC_R_MIPI_0_PWM_0>;
	};

	// Actual PWM controller
	pwm_mipi0: pwm@56224000 {
		compatible = "fsl,imx8qm-pwm", "fsl,imx27-pwm";
		reg = <0x56224000 0x1000>;
		clocks = <&mipi0_pwm_lpcg_ipg_clk_highfreq 0>,
				<&mipi0_pwm_lpcg_ipg_clk 0>;
		clock-names = "per", "ipg";
		assigned-clocks = <&clk IMX_SC_R_MIPI_0_PWM_0 IMX_SC_PM_CLK_PER>;
		assigned-clock-rates = <24000000>;
		#pwm-cells = <2>;
		power-domains = <&pd IMX_SC_R_MIPI_0_PWM_0>;
		status = "disabled";
	};
};

// DSI1 - aux-board connector (backlight is defined above)

&mipi1_subsys {
	// Clocks for the MIPI DSI1 PWM subsystem
	mipi1_pwm_lpcg_ipg_clk_highfreq: clock-controller@57223010 {
		compatible = "fsl,imx8qxp-lpcg";
		reg = <0x57223010 0x4>;
		#clock-cells = <1>;
		clocks = <&clk IMX_SC_R_MIPI_1_PWM_0 IMX_SC_PM_CLK_PER>;
		bit-offset = <0>;
		clock-output-names = "mipi1_pwm_lpcg_ipg_clk_highfreq";
		power-domains = <&pd IMX_SC_R_MIPI_1_PWM_0>;
	};

	mipi1_pwm_lpcg_ipg_s_clk: clock-controller@5722300c {
		compatible = "fsl,imx8qxp-lpcg";
		reg = <0x5722300c 0x4>;
		#clock-cells = <1>;
		clocks = <&dsi_ipg_clk>;
		bit-offset = <0>;
		clock-output-names = "mipi1_pwm_lpcg_ipg_s_clk";
		power-domains = <&pd IMX_SC_R_MIPI_1_PWM_0>;
	};

	mipi1_pwm_lpcg_ipg_clk: clock-controller@57223008 {
		compatible = "fsl,imx8qxp-lpcg";
		reg = <0x57223008 0x4>;
		#clock-cells = <1>;
		clocks = <&mipi1_pwm_lpcg_ipg_s_clk 0>;
		bit-offset = <0>;
		clock-output-names = "mipi1_pwm_lpcg_ipg_clk";
		power-domains = <&pd IMX_SC_R_MIPI_1_PWM_0>;
	};

	// Actual PWM controller
	pwm_mipi1: pwm@57224000 {
		compatible = "fsl,imx8qm-pwm", "fsl,imx27-pwm";
		reg = <0x57224000 0x1000>;
		clocks = <&mipi1_pwm_lpcg_ipg_clk_highfreq 0>,
				<&mipi1_pwm_lpcg_ipg_clk 0>;
		clock-names = "per", "ipg";
		assigned-clocks = <&clk IMX_SC_R_MIPI_1_PWM_0 IMX_SC_PM_CLK_PER>;
		assigned-clock-rates = <24000000>;
		#pwm-cells = <2>;
		power-domains = <&pd IMX_SC_R_MIPI_1_PWM_0>;
		status = "disabled";
	};
};

// HDMI TX

&sai5 {
	status = "okay";
};

&sai5_lpcg {
	status = "okay";
};

&irqsteer_hdmi {
	status = "okay";
};

&hdmi_lpcg_i2c0 {
	status = "okay";
};

&hdmi_lpcg_lis_ipg {
	status = "okay";
};

&hdmi_lpcg_pwm_ipg {
	status = "okay";
};

&hdmi_lpcg_i2s {
	status = "okay";
};

&hdmi_lpcg_gpio_ipg {
	status = "okay";
};

&hdmi_lpcg_msi_hclk {
	status = "okay";
};

&hdmi_lpcg_pxl {
	status = "okay";
};

&hdmi_lpcg_phy {
	status = "okay";
};

&hdmi_lpcg_apb_mux_csr {
	status = "okay";
};

&hdmi_lpcg_apb_mux_ctrl {
	status = "okay";
};

&hdmi_lpcg_apb {
	status = "okay";
};

&hdmi {
	compatible = "cdn,imx8qm-hdmi";
	firmware-name = "hdmitxfw.bin";
	lane-mapping = <0x93>;
	hdcp-config = <0x3>;
	status = "okay";
};

&spdif1 {
	status = "okay";
};

&spdif1_lpcg {
	status = "okay";
};

// QSPI

&flexspi0 { // On-board QSPI for the flash chip
	pinctrl-names = "default";
	pinctrl-0 = <&pinctrl_flexspi0>;
	nxp,fspi-dll-slvdly = <5>;
	status = "okay";

	flash0: w25q01jv@0 {
		reg = <0>;
		#address-cells = <1>;
		#size-cells = <1>;
		compatible = "winbond,w25q01jv", "jedec,spi-nor";
		spi-max-frequency = <104000000>;
		spi-tx-bus-width = <4>;
		spi-rx-bus-width = <4>;
	};
};

// I2C

&i2c0 { // I2C bus with USB HSIC hub
	#address-cells = <1>;
	#size-cells = <0>;
	clock-frequency = <100000>;
	pinctrl-names = "default";
	pinctrl-0 = <&pinctrl_i2c0>;
	status = "okay";
};

&i2c1 { // I2C bus with temperature sensor
	#address-cells = <1>;
	#size-cells = <0>;
	clock-frequency = <100000>;
	pinctrl-names = "default";
	pinctrl-0 = <&pinctrl_i2c1>;
	status = "okay";

	tc74a5: tc74a5@4d {
		compatible = "tc74";
		reg = <0x4d>;
	};
};

&i2c2 { // I2C bus with EEPROM
	#address-cells = <1>;
	#size-cells = <0>;
	clock-frequency = <100000>;
	pinctrl-names = "default";
	pinctrl-0 = <&pinctrl_i2c2>;
	status = "okay";

	eeprom: eeprom@50 {
		compatible = "atmel,24c64"; // Our chip is a 24AA64, which is the same except for a lower clock speed
		reg = <0x50>;
	};
};

&cm41_i2c { // Debug I2C bus
	#address-cells = <1>;
	#size-cells = <0>;
	clock-frequency = <100000>;
	pinctrl-names = "default";
	pinctrl-0 = <&pinctrl_cm41_i2c>;
	status = "okay";
};

// UART

&lpuart1 { // Debug UART
	pinctrl-names = "default";
	pinctrl-0 = <&pinctrl_lpuart1>;
	status = "okay";
};

// GPIO line names

&lsio_gpio0 {
	gpio-line-names =
	//  0       1       2       3       4       5
		"aux0", "aux1", "aux2", "aux3", "aux4", "aux5",
	//  6   7   8         9         10  11
		"", "", "debug0", "debug1", "", "",
	//  12        13        14  15  16  17
		"debug2", "debug3", "", "", "", "",
	//  18  19  20  21  22  23
		"", "", "", "", "", "",
	//  24  25  26  27  28          29
		"", "", "", "", "version0", "version1",
	//  30          31
		"version2", "version3";
};

&lsio_gpio1 {
	gpio-line-names =
	//  0   1   2   3          4          5
		"", "", "", "switch0", "switch1", "switch2",
	//  6          7          8          9   10  11
		"switch3", "switch4", "switch5", "", "", "",
	//  12  13  14  15  16  17
		"", "", "", "", "", "",
	//  18  19  20  21  22  23
		"", "", "", "", "", "",
	//  24  25  26  27  28  29
		"", "", "", "", "", "",
	//  30  31
		"", "";
};


// CAN busses

&flexcan1 {
	pinctrl-names = "default";
	pinctrl-0 = <&pinctrl_flexcan1>;
	status = "okay";
};

&flexcan2 {
	pinctrl-names = "default";
	pinctrl-0 = <&pinctrl_flexcan2>;
	status = "okay";
};

// Ethernet

&fec1 {
	pinctrl-names = "default";
	pinctrl-0 = <&pinctrl_fec1>;
	phy-mode = "rgmii-txid";
	phy-handle = <&ethphy0>;
	fsl,magic-packet;
	nvmem-cells = <&fec_mac0>;
	nvmem-cell-names = "mac-address";
	rx-internal-delay-ps = <2000>;
	status = "okay";

	mdio {
		#address-cells = <1>;
		#size-cells = <0>;

		ethphy0: ethernet-phy@1 {
			compatible = "ethernet-phy-ieee802.3-c22";
			reg = <1>;
			pinctrl-names = "default";
			pinctrl-0 = <&pinctrl_ethphy0>;
			interrupt-parent = <&lsio_gpio0>;
			interrupts = <16 IRQ_TYPE_LEVEL_LOW>;
		};
	};
};

// PCIe (instead of two separate PCIe channels, we have one with two lanes)

&pciea {
	ext_osc = <1>;
	pinctrl-names = "default";
	pinctrl-0 = <&pinctrl_pciea>;
	reset-gpio = <&lsio_gpio4 29 GPIO_ACTIVE_LOW>;
	clkreq-gpio = <&lsio_gpio4 30 GPIO_ACTIVE_LOW>;
	num-lanes = <2>;
	hsio-cfg = <PCIEAX2SATA>;
	status = "okay";
};

// SATA

&sata {
	pinctrl-names = "default";
	pinctrl-0 = <&pinctrl_sata>;
	clkreq-gpio = <&lsio_gpio4 30 GPIO_ACTIVE_LOW>;
	ext_osc = <1>;
	status = "okay";
};

// USDHC

&usdhc1 { // Builtin eMMC
	pinctrl-names = "default", "state_100mhz", "state_200mhz";
	pinctrl-0 = <&pinctrl_usdhc1>;
	pinctrl-1 = <&pinctrl_usdhc1>;
	pinctrl-2 = <&pinctrl_usdhc1>;
	bus-width = <8>;
	no-sd;
	no-sdio;
	non-removable;
	status = "okay";
};

&usdhc3 { // MicroSD card
	pinctrl-names = "default", "state_100mhz", "state_200mhz";
	pinctrl-0 = <&pinctrl_usdhc3>;
	pinctrl-1 = <&pinctrl_usdhc3>;
	pinctrl-2 = <&pinctrl_usdhc3>;
	bus-width = <4>;
	status = "okay";
	no-1-8-v;
};

// ADC (voltage/current monitors)

&adc0 {
	#io-channel-cells = <1>;
	pinctrl-names = "default";
	pinctrl-0 = <&pinctrl_adc0>;
	vref-supply = <&reg_vref_1v8>;
	status = "okay";
};

&adc1 {
	compatible = "nxp,imx8qxp-adc";
	#io-channel-cells = <1>;
	pinctrl-names = "default";
	pinctrl-0 = <&pinctrl_adc1>;
	vref-supply = <&reg_vref_1v8>;
	status = "okay";
};

// Fans

&lsio_subsys {
	lsio_pwm0: pwm@5d000000 {
		compatible = "fsl,imx27-pwm";
		reg = <0x5d000000 0x10000>;
		clock-names = "ipg", "per";
		clocks = <&pwm0_lpcg 4>, <&pwm0_lpcg 1>;
		assigned-clocks = <&clk IMX_SC_R_PWM_0 IMX_SC_PM_CLK_PER>;
		assigned-clock-rates = <24000000>;
		#pwm-cells = <3>;
		interrupts = <GIC_SPI 94 IRQ_TYPE_LEVEL_HIGH>;
	};

	lsio_pwm1: pwm@5d010000 {
		compatible = "fsl,imx27-pwm";
		reg = <0x5d010000 0x10000>;
		clock-names = "ipg", "per";
		clocks = <&pwm1_lpcg 4>, <&pwm1_lpcg 1>;
		assigned-clocks = <&clk IMX_SC_R_PWM_1 IMX_SC_PM_CLK_PER>;
		assigned-clock-rates = <24000000>;
		#pwm-cells = <3>;
		interrupts = <GIC_SPI 95 IRQ_TYPE_LEVEL_HIGH>;
	};

	lsio_pwm2: pwm@5d020000 {
		compatible = "fsl,imx27-pwm";
		reg = <0x5d020000 0x10000>;
		clock-names = "ipg", "per";
		clocks = <&pwm2_lpcg 4>, <&pwm2_lpcg 1>;
		assigned-clocks = <&clk IMX_SC_R_PWM_2 IMX_SC_PM_CLK_PER>;
		assigned-clock-rates = <24000000>;
		#pwm-cells = <3>;
		interrupts = <GIC_SPI 96 IRQ_TYPE_LEVEL_HIGH>;
	};
};

// Enable processing units

&dpu1 {
	status = "okay";
};

&dpu2 {
	status = "okay";
};

&dsp {
	compatible = "fsl,imx8qm-hifi4";
	memory-region = <&dsp_vdev0buffer>, <&dsp_vdev0vring0>,
			<&dsp_vdev0vring1>, <&dsp_reserved>;
	status = "okay";
};

&gpu_3d0 {
	status = "okay";
};

&gpu_3d1 {
	status = "okay";
};

&imx8_gpu_ss {
	memory-region=<&gpu_reserved>;
	status = "okay";
};

&vpu {
	compatible = "nxp,imx8qm-vpu";
	status = "okay";
};

&vpu_core0 {
	reg = <0x2d080000 0x10000>;
	memory-region = <&decoder_boot>, <&decoder_rpc>;
	status = "okay";
};

&vpu_core1 {
	reg = <0x2d090000 0x10000>;
	memory-region = <&encoder1_boot>, <&encoder1_rpc>;
	status = "okay";
};

&vpu_core2 {
	reg = <0x2d0a0000 0x10000>;
	memory-region = <&encoder2_boot>, <&encoder2_rpc>;
	status = "okay";
};

&jpegdec {
	status = "okay";
};

&jpegenc {
	status = "okay";
};

// M4 core communication

&lsio_mu5 {
	status = "okay";
};

&lsio_mu6 {
	status = "okay";
};

&cm40_intmux {
	status = "okay";
};

&cm41_intmux {
	status = "okay";
};

// Display controllers

&dc0_pc {
	status = "okay";
};

&dc0_prg1 {
	status = "okay";
};

&dc0_prg2 {
	status = "okay";
};

&dc0_prg3 {
	status = "okay";
};

&dc0_prg4 {
	status = "okay";
};

&dc0_prg5 {
	status = "okay";
};

&dc0_prg6 {
	status = "okay";
};

&dc0_prg7 {
	status = "okay";
};

&dc0_prg8 {
	status = "okay";
};

&dc0_prg9 {
	status = "okay";
};

&dc0_dpr1_channel1 {
	status = "okay";
};

&dc0_dpr1_channel2 {
	status = "okay";
};

&dc0_dpr1_channel3 {
	status = "okay";
};

&dc0_dpr2_channel1 {
	status = "okay";
};

&dc0_dpr2_channel2 {
	status = "okay";
};

&dc0_dpr2_channel3 {
	status = "okay";
};

&dc1_pc {
	status = "okay";
};

&dc1_prg1 {
	status = "okay";
};

&dc1_prg2 {
	status = "okay";
};

&dc1_prg3 {
	status = "okay";
};

&dc1_prg4 {
	status = "okay";
};

&dc1_prg5 {
	status = "okay";
};

&dc1_prg6 {
	status = "okay";
};

&dc1_prg7 {
	status = "okay";
};

&dc1_prg8 {
	status = "okay";
};

&dc1_prg9 {
	status = "okay";
};

&dc1_dpr1_channel1 {
	status = "okay";
};

&dc1_dpr1_channel2 {
	status = "okay";
};

&dc1_dpr1_channel3 {
	status = "okay";
};

&dc1_dpr2_channel1 {
	status = "okay";
};

&dc1_dpr2_channel2 {
	status = "okay";
};

&dc1_dpr2_channel3 {
	status = "okay";
};

// Image sensor innterface

&isi_0 {
	status = "okay";

	cap_device {
		status = "okay";
	};

	m2m_device {
		status = "okay";
	};
};

&isi_1 {
	status = "okay";

	cap_device {
		status = "okay";
	};
};

&isi_2 {
	status = "okay";

	cap_device {
		status = "okay";
	};
};

&isi_3 {
	status = "okay";

	cap_device {
		status = "okay";
	};
};

&isi_4 {
	status = "okay";

	cap_device {
		status = "okay";
	};
};

&isi_5 {
	status = "okay";

	cap_device {
		status = "okay";
	};
};

&isi_6 {
	status = "okay";

	cap_device {
		status = "okay";
	};
};

&isi_7 {
	status = "okay";

	cap_device {
		status = "okay";
	};
};

// DSP communication

&mu_m0 {
	interrupts = <GIC_SPI 472 IRQ_TYPE_LEVEL_HIGH>;
};

&mu1_m0 {
	interrupts = <GIC_SPI 473 IRQ_TYPE_LEVEL_HIGH>;
};

&mu2_m0 {
	interrupts = <GIC_SPI 474 IRQ_TYPE_LEVEL_HIGH>;
	status = "okay";
};

// Thermal control

&thermal_zones {
	pmic-thermal0 {
		polling-delay-passive = <250>;
		polling-delay = <2000>;
		thermal-sensors = <&tsens IMX_SC_R_PMIC_0>;
		trips {
			pmic_alert0: trip0 {
				temperature = <110000>;
				hysteresis = <2000>;
				type = "passive";
			};
			pmic_crit0: trip1 {
				temperature = <125000>;
				hysteresis = <2000>;
				type = "critical";
			};
		};
		cooling-maps {
			map0 {
				trip = <&pmic_alert0>;
				cooling-device =
				<&A53_0 THERMAL_NO_LIMIT THERMAL_NO_LIMIT>,
				<&A53_1 THERMAL_NO_LIMIT THERMAL_NO_LIMIT>,
				<&A53_2 THERMAL_NO_LIMIT THERMAL_NO_LIMIT>,
				<&A53_3 THERMAL_NO_LIMIT THERMAL_NO_LIMIT>,
				<&A72_0 THERMAL_NO_LIMIT THERMAL_NO_LIMIT>,
				<&A72_1 THERMAL_NO_LIMIT THERMAL_NO_LIMIT>;
			};
		};
	};

	cpu-thermal2 { // Fan cooling based on the temperature of the A53 cores
		polling-delay-passive = <250>;
		polling-delay = <2000>;
		thermal-sensors = <&tsens IMX_SC_R_A53>;
		trips {
			cpu_alert2a: trip0 {
				temperature = <50000>;
				hysteresis = <2000>;
				type = "active";
			};
			cpu_alert2b: trip1 {
				temperature = <107000>;
				hysteresis = <2000>;
				type = "passive";
			};
			cpu_crit2: trip2 {
				temperature = <127000>;
				hysteresis = <2000>;
				type = "critical";
			};
		};
		cooling-maps {
			map0 {
				trip = <&cpu_alert2a>;
				cooling-device = <&pwm_fan0 THERMAL_NO_LIMIT 4>;
			};
			map1 {
				trip = <&cpu_alert2b>;
				cooling-device = <&pwm_fan0 4 THERMAL_NO_LIMIT>;
			};
		};
	};
};

// Pin mux control

&iomuxc {
	pinctrl-names = "default";
	pinctrl-0 = <&pinctrl_hog>;

	// For a value like 0x06000021 the bits are usually (for GPIOs)
	//                     |    ||
	//     IO config ------+    ||  (0=default, 2=open drain, 4=open drain input, 6=in out)
	//     Pull-up/down --------+|  (0=bus keeper, 2=pull up, 4=pull down, 6=no pull)
	//     Drive strength -------+
	//
	// Exceptions abound though, check out the IMX8QMRM for the exact values for each pin

	pinctrl_hog: hoggrp {
		fsl,pins = <
			// Board version GPIOs
			IMX8QM_SCU_GPIO0_00_LSIO_GPIO0_IO28					0x06000061
			IMX8QM_SCU_GPIO0_01_LSIO_GPIO0_IO29					0x06000061
			IMX8QM_SCU_GPIO0_02_LSIO_GPIO0_IO30					0x06000061
			IMX8QM_SCU_GPIO0_03_LSIO_GPIO0_IO31					0x06000061

			// Debug switch array (no pull as pull up overwhelms the HW pull down)
			IMX8QM_SCU_GPIO0_07_LSIO_GPIO1_IO03					0x06000061
			IMX8QM_LVDS0_GPIO00_LSIO_GPIO1_IO04					0x06000061
			IMX8QM_LVDS0_GPIO01_LSIO_GPIO1_IO05					0x06000061
			IMX8QM_LVDS0_I2C0_SCL_LSIO_GPIO1_IO06				0x06000061
			IMX8QM_LVDS0_I2C0_SDA_LSIO_GPIO1_IO07				0x06000061
			IMX8QM_LVDS0_I2C1_SCL_LSIO_GPIO1_IO08				0x06000061
		>;
	};

	pinctrl_pmic_ldo0: pmicldo0grp {
		fsl,pins = <
			IMX8QM_USDHC1_VSELECT_LSIO_GPIO4_IO08				0x06000021
		>;
	};

	pinctrl_level_shifters: levelshiftersgrp {
		fsl,pins = <
			IMX8QM_SPDIF0_TX_LSIO_GPIO2_IO15					0x06000021
		>;
	};

	pinctrl_cm41_i2c: cm41i2cgrp {
		fsl,pins = <
			IMX8QM_M41_I2C0_SDA_M41_I2C0_SDA					0x04000020
			IMX8QM_M41_I2C0_SCL_M41_I2C0_SCL					0x04000020
		>;
	};

	pinctrl_adc0: adc0grp {
		fsl,pins = <
			IMX8QM_ADC_IN0_DMA_ADC0_IN0							0xc0000060
			IMX8QM_ADC_IN1_DMA_ADC0_IN1							0xc0000060
			IMX8QM_ADC_IN2_DMA_ADC0_IN2							0xc0000060
			IMX8QM_ADC_IN3_DMA_ADC0_IN3							0xc0000060
		>;
	};

	pinctrl_adc1: adc1grp {
		fsl,pins = <
			IMX8QM_ADC_IN4_DMA_ADC1_IN0							0xc0000060
			IMX8QM_ADC_IN5_DMA_ADC1_IN1							0xc0000060
			IMX8QM_ADC_IN6_DMA_ADC1_IN2							0xc0000060
			IMX8QM_ADC_IN7_DMA_ADC1_IN3							0xc0000060
		>;
	};

	pinctrl_fan0: fan0grp {
		fsl,pins = <
			IMX8QM_UART0_RTS_B_LSIO_PWM0_OUT					0x06000021
			IMX8QM_SCU_GPIO0_04_LSIO_GPIO1_IO00					0x06000021
		>;
	};

	pinctrl_fan1: fan1grp {
		fsl,pins = <
			IMX8QM_UART0_CTS_B_LSIO_PWM1_OUT					0x06000021
			IMX8QM_SCU_GPIO0_05_LSIO_GPIO1_IO01					0x06000021
		>;
	};

	pinctrl_fan2: fan2grp {
		fsl,pins = <
			IMX8QM_GPT1_COMPARE_LSIO_PWM2_OUT					0x06000021
			IMX8QM_SCU_GPIO0_06_LSIO_GPIO1_IO02					0x06000021
		>;
	};

	pinctrl_leds: ledsgrp {
		fsl,pins = <
			IMX8QM_UART0_RX_LSIO_GPIO0_IO20						0x06000040
			IMX8QM_UART0_TX_LSIO_GPIO0_IO21						0x06000040
		>;
	};

	pinctrl_fec1: fec1grp {
		fsl,pins = <
			IMX8QM_COMP_CTL_GPIO_1V8_3V3_ENET_ENETB_PAD			0x000014a0
			IMX8QM_ENET0_MDC_CONN_ENET0_MDC						0x06000020
			IMX8QM_ENET0_MDIO_CONN_ENET0_MDIO					0x06000020
			IMX8QM_ENET0_RGMII_TX_CTL_CONN_ENET0_RGMII_TX_CTL	0x06000020
			IMX8QM_ENET0_RGMII_TXC_CONN_ENET0_RGMII_TXC			0x06000020
			IMX8QM_ENET0_RGMII_TXD0_CONN_ENET0_RGMII_TXD0		0x06000020
			IMX8QM_ENET0_RGMII_TXD1_CONN_ENET0_RGMII_TXD1		0x06000020
			IMX8QM_ENET0_RGMII_TXD2_CONN_ENET0_RGMII_TXD2		0x06000020
			IMX8QM_ENET0_RGMII_TXD3_CONN_ENET0_RGMII_TXD3		0x06000020
			IMX8QM_ENET0_RGMII_RXC_CONN_ENET0_RGMII_RXC			0x06000020
			IMX8QM_ENET0_RGMII_RX_CTL_CONN_ENET0_RGMII_RX_CTL	0x06000020
			IMX8QM_ENET0_RGMII_RXD0_CONN_ENET0_RGMII_RXD0		0x06000020
			IMX8QM_ENET0_RGMII_RXD1_CONN_ENET0_RGMII_RXD1		0x06000020
			IMX8QM_ENET0_RGMII_RXD2_CONN_ENET0_RGMII_RXD2		0x06000020
			IMX8QM_ENET0_RGMII_RXD3_CONN_ENET0_RGMII_RXD3		0x06000020
		>;
	};

	pinctrl_ethphy0: ethphy0grp {
		fsl,pins = <
			IMX8QM_GPT0_COMPARE_LSIO_GPIO0_IO16					0x06000021
		>;
	};

	pinctrl_flexspi0: flexspi0grp {
		fsl,pins = <
			IMX8QM_QSPI0A_DATA0_LSIO_QSPI0A_DATA0				0x06000021
			IMX8QM_QSPI0A_DATA1_LSIO_QSPI0A_DATA1				0x06000021
			IMX8QM_QSPI0A_DATA2_LSIO_QSPI0A_DATA2				0x06000021
			IMX8QM_QSPI0A_DATA3_LSIO_QSPI0A_DATA3				0x06000021
			IMX8QM_QSPI0A_SS0_B_LSIO_QSPI0A_SS0_B				0x06000021
			IMX8QM_QSPI0A_SCLK_LSIO_QSPI0A_SCLK					0x06000021
		>;
	};

	pinctrl_flexcan1: flexcan0grp {
		fsl,pins = <
			IMX8QM_FLEXCAN0_TX_DMA_FLEXCAN0_TX					0x00000021
			IMX8QM_FLEXCAN0_RX_DMA_FLEXCAN0_RX					0x00000021
		>;
	};

	pinctrl_flexcan2: flexcan1grp {
		fsl,pins = <
			IMX8QM_FLEXCAN1_TX_DMA_FLEXCAN1_TX					0x00000021
			IMX8QM_FLEXCAN1_RX_DMA_FLEXCAN1_RX					0x00000021
		>;
	};

	pinctrl_i2c0: i2c0grp {
		fsl,pins = <
			IMX8QM_HDMI_TX0_TS_SCL_DMA_I2C0_SCL					0x04000020
			IMX8QM_HDMI_TX0_TS_SDA_DMA_I2C0_SDA					0x04000020
		>;
	};

	pinctrl_i2c1: i2c1grp {
		fsl,pins = <
			IMX8QM_GPT0_CLK_DMA_I2C1_SCL						0x04000020
			IMX8QM_GPT0_CAPTURE_DMA_I2C1_SDA					0x04000020
		>;
	};

	pinctrl_i2c2: i2c2grp {
		fsl,pins = <
			IMX8QM_GPT1_CLK_DMA_I2C2_SCL						0x04000020
			IMX8QM_GPT1_CAPTURE_DMA_I2C2_SDA					0x04000020
		>;
	};

	pinctrl_lpuart1: lpuart1grp {
		fsl,pins = <
			IMX8QM_UART1_RX_DMA_UART1_RX						0x06000020
			IMX8QM_UART1_TX_DMA_UART1_TX						0x06000020
			IMX8QM_UART1_CTS_B_DMA_UART1_CTS_B					0x06000020
			IMX8QM_UART1_RTS_B_DMA_UART1_RTS_B					0x06000020
		>;
	};

	pinctrl_pciea: pcieagrp {
		fsl,pins = <
			IMX8QM_PCIE_CTRL0_WAKE_B_LSIO_GPIO4_IO28			0x04000021
			IMX8QM_PCIE_CTRL0_PERST_B_LSIO_GPIO4_IO29			0x06000021
			IMX8QM_PCIE_CTRL0_CLKREQ_B_LSIO_GPIO4_IO27			0x06000021
		>;
	};

	pinctrl_sata: satagrp {
		fsl,pins = <
			IMX8QM_PCIE_CTRL1_CLKREQ_B_LSIO_GPIO4_IO30			0x06000021
		>;
	};

	pinctrl_usdhc1: usdhc1grp {
		fsl,pins = <
			IMX8QM_EMMC0_CLK_CONN_EMMC0_CLK						0x06000041
			IMX8QM_EMMC0_CMD_CONN_EMMC0_CMD						0x00000021
			IMX8QM_EMMC0_DATA0_CONN_EMMC0_DATA0					0x00000021
			IMX8QM_EMMC0_DATA1_CONN_EMMC0_DATA1					0x00000021
			IMX8QM_EMMC0_DATA2_CONN_EMMC0_DATA2					0x00000021
			IMX8QM_EMMC0_DATA3_CONN_EMMC0_DATA3					0x00000021
			IMX8QM_EMMC0_DATA4_CONN_EMMC0_DATA4					0x00000021
			IMX8QM_EMMC0_DATA5_CONN_EMMC0_DATA5					0x00000021
			IMX8QM_EMMC0_DATA6_CONN_EMMC0_DATA6					0x00000021
			IMX8QM_EMMC0_DATA7_CONN_EMMC0_DATA7					0x00000021
			IMX8QM_EMMC0_STROBE_CONN_EMMC0_STROBE				0x00000041
		>;
	};

	pinctrl_usdhc3: usdhc3grp {
		fsl,pins = <
			IMX8QM_USDHC2_CLK_CONN_USDHC2_CLK					0x06000041
			IMX8QM_USDHC2_CMD_CONN_USDHC2_CMD					0x00000021
			IMX8QM_USDHC2_DATA0_CONN_USDHC2_DATA0				0x00000021
			IMX8QM_USDHC2_DATA1_CONN_USDHC2_DATA1				0x00000021
			IMX8QM_USDHC2_DATA2_CONN_USDHC2_DATA2				0x00000021
			IMX8QM_USDHC2_DATA3_CONN_USDHC2_DATA3				0x00000021
			IMX8QM_USDHC2_VSELECT_CONN_USDHC2_VSELECT			0x00000021
		>;
	};
};
