// SPDX-License-Identifier: GPL-2.0+
/*
 * Copyright 2024 Refeyn
 *	Matthew Joyce <matthew.joyce@refeyn.com>
 */

/dts-v1/;

#include "imx8qm-ec-asm-00014-03.dtsi"
#include "imx8qm-ec-asm-00027-01.dtsi"

/ {
	model = "Refeyn i.MX8QM EC-ASM-00014-03 with EC-ASM-00027-01";
};
