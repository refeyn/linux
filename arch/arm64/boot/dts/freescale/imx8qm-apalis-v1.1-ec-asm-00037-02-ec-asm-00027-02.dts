// SPDX-License-Identifier: GPL-2.0-or-later OR MIT
/*
 * Copyright 2025 Refeyn
 */

/dts-v1/;

#include "imx8qm-apalis-v1.1.dtsi"
#include "imx8-apalis-ec-asm-00037-02.dtsi"
#include "imx8-apalis-ec-asm-00027-02.dtsi"

/ {
	model = "Toradex Apalis iMX8QM V1.1 on EC-ASM-00037-02 Checkmate carrier board with EC-ASM-00027-02 CheckMate Aux PCB";
	compatible = "toradex,apalis-imx8-v1.1-ec-asm-00037-02-ec-asm-00027-02",
		     "toradex,apalis-imx8-v1.1",
		     "fsl,imx8qm";
};
