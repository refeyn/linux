// SPDX-License-Identifier: GPL-2.0-or-later OR MIT
/*
 * Copyright 2024 Toradex
 * Copyright 2025 Refeyn
 *
 * Device tree for EC-ASM-00044-01 CheckMate Main Board with EC-ASM-00048-01 CheckMate Screen Adaptor
 */

/dts-v1/;

#include "k3-am69-aquila.dtsi"
#include "k3-am69-aquila-ec-asm-00044-01.dtsi"
#include "k3-am69-aquila-ec-asm-00048-01.dtsi"

/ {
	model = "Toradex Aquila AM69 v1.1 on EC-ASM-00044-01 CheckMate Main Board (with no aux board)";
	compatible = "toradex,aquila-am69-ec-asm-00044-01-ec-asm-00048-01",
		     "toradex,aquila-am69",
		     "ti,j784s4";
};
