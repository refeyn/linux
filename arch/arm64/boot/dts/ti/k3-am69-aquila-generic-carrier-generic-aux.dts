// SPDX-License-Identifier: GPL-2.0-or-later OR MIT
/*
 * Copyright 2024 Toradex
 * Copyright 2025 Refeyn
 *
 * Device tree for generic carrier
 */

/dts-v1/;

#include "k3-am69-aquila.dtsi"
#include "k3-am69-aquila-generic-carrier.dtsi"
#include "k3-am69-aquila-generic-aux.dtsi"

/ {
	model = "Toradex Aquila AM69 on generic carrier";
	compatible = "toradex,aquila-am69-generic-carrier-generic-aux",
		     "toradex,aquila-am69",
		     "ti,j784s4";
};
