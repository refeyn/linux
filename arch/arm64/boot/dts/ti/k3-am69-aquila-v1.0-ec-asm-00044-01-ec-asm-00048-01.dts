// SPDX-License-Identifier: GPL-2.0-or-later OR MIT
/*
 * Copyright (C) 2025 Toradex
 * Copyright 2025 Refeyn
 *
 * Device tree for EC-ASM-00044-01 CheckMate Main Board with EC-ASM-00048-01 CheckMate Screen Adaptor
 */

#include "k3-am69-aquila-v1.1-ec-asm-00044-01-ec-asm-00048-01.dts"
#include "k3-am69-aquila-v1.0.dtsi"

/ {
	model = "Toradex Aquila AM69 v1.0 on EC-ASM-00044-01 CheckMate Main Board with EC-ASM-00048-01 CheckMate Screen Adaptor";
};

/* Aquila UART_1 (SoM v1.0) */
&main_uart1 {
	status = "okay";
	pinctrl-0 =
		// UART
		<&pinctrl_main_uart1>,
		// GPIOs
		<&pinctrl_gpio_04>, // RTCPU_RESET
		<&pinctrl_gpio_05>, // RTCPU_MODE_0
		<&pinctrl_gpio_06>; // RTCPU_MODE_1
};
